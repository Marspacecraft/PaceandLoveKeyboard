/*****************************************************************************
* | File      	:   EPD_2in7_V2.c
* | Author      :   Waveshare team
* | Function    :   2.7inch V2 e-paper
* | Info        :
*----------------
* |	This version:   V1.0
* | Date        :   2022-08-18
* | Info        :
* -----------------------------------------------------------------------------
#
# Permission is hereby granted, free of charge, to any person obtaining a copy
# of this software and associated documnetation files (the "Software"), to deal
# in the Software without restriction, including without limitation the rights
# to use, copy, modify, merge, publish, distribute, sublicense, and/or sell
# copies of the Software, and to permit persons to  whom the Software is
# furished to do so, subject to the following conditions:
#
# The above copyright notice and this permission notice shall be included in
# all copies or substantial portions of the Software.
#
# THE SOFTWARE IS PROVIDED "AS IS", WITHOUT WARRANTY OF ANY KIND, EXPRESS OR
# IMPLIED, INCLUDING BUT NOT LIMITED TO THE WARRANTIES OF MERCHANTABILITY,
# FITNESS OR A PARTICULAR PURPOSE AND NONINFRINGEMENT. IN NO EVENT SHALL THE
# AUTHORS OR COPYRIGHT HOLDERS BE LIABLE FOR ANY CLAIM, DAMAGES OR OTHER
# LIABILITY WHETHER IN AN ACTION OF CONTRACT, TORT OR OTHERWISE, ARISING FROM,
# OUT OF OR IN CONNECTION WITH THE SOFTWARE OR THE USE OR OTHER DEALINGS IN
# THE SOFTWARE.
#
******************************************************************************/
#include "EPD_2in7_V2.h"
#include <stdlib.h>
#include "keyconfig.h"
#include "memery.h"
#include "fatfs.h"
#include "tracelog.h"
//#include "Debug.h"
#ifdef SPI_EPAPER

void EPD_2IN7_V2_Init(void);
void EPD_2IN7_V2_Init_Fast(void);
void EPD_2IN7_V2_Clear(void);
void EPD_2IN7_V2_Display(UBYTE *Image);
void EPD_2IN7_V2_Display_Partial( UBYTE *Image, UWORD Xstart, UWORD Ystart, UWORD Xend, UWORD Yende);
void EPD_2IN7_V2_Sleep(void);
ePaperFrame_t Hinata = {
.type = EPD_TYPE_FRAME,
.bmp.body= {/* 0X00,0X01,0XB0,0X00,0X08,0X01, */
0XFF,0XFF,0XFF,0XFF,0XFF,0XFF,0XFF,0XFF,0XFF,0XFF,0XFF,0XFF,0XFF,0XFF,0XFF,0XFF,
0XFF,0XFF,0XFF,0XFF,0XFF,0XFF,0XFF,0XFF,0XFF,0XFF,0XFF,0XFF,0XFF,0XFF,0XFF,0XFF,
0XFF,0XFF,0XFF,0XFF,0XFF,0XFF,0XFF,0XFF,0XFF,0XFF,0XFF,0XFF,0XFF,0XFF,0XFF,0XFF,
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0XFF,0XFF,0XFF,0XFF,0XFF,0XFF,0XFF,0XFF,0XFF,0XFF,0XFF,0XFF,0XFF,0XFF,0XFF,0XFF,



}
};


/******************************************************************************
function :	Software reset
parameter:
******************************************************************************/
static void EPD_2IN7_V2_Reset(void)
{
    DEV_Digital_Write(EPD_RST_PIN, 1);
    DEV_Delay_ms(20);
    DEV_Digital_Write(EPD_RST_PIN, 0);
    DEV_Delay_ms(2);
    DEV_Digital_Write(EPD_RST_PIN, 1);
    DEV_Delay_ms(20);
}

/******************************************************************************
function :	send command
parameter:
     Reg : Command register
******************************************************************************/
static void EPD_2IN7_V2_SendCommand(UBYTE Reg)
{
    DEV_Digital_Write(EPD_DC_PIN, 0);
    DEV_Digital_Write(EPD_CS_PIN, 0);
    DEV_SPI_WriteByte(Reg);
    DEV_Digital_Write(EPD_CS_PIN, 1);
}

/******************************************************************************
function :	send data
parameter:
    Data : Write data
******************************************************************************/
static void EPD_2IN7_V2_SendData(UBYTE Data)
{
    DEV_Digital_Write(EPD_DC_PIN, 1);
    DEV_Digital_Write(EPD_CS_PIN, 0);
    DEV_SPI_WriteByte(Data);
    DEV_Digital_Write(EPD_CS_PIN, 1);
}

/******************************************************************************
function :	Wait until the busy_pin goes LOW
parameter:
******************************************************************************/
static void EPD_2IN7_V2_ReadBusy(void)
{
	uint8_t count = 100;
    //Debug("e-Paper busy\r\n");
    do {
        if(DEV_Digital_Read(EPD_BUSY_PIN) == 0)
			break;
		DEV_Delay_ms(5);
    } while(count--);
    DEV_Delay_ms(20);
    //Debug("e-Paper busy release\r\n");
}

/******************************************************************************
function :	Turn on display
parameter:
******************************************************************************/
static void EPD_2IN7_V2_TurnOnDisplay(void)
{
	EPD_2IN7_V2_SendCommand(0x22); //Display Update Control
	EPD_2IN7_V2_SendData(0xF7);
	EPD_2IN7_V2_SendCommand(0x20); //Activate Display Update Sequence
	EPD_2IN7_V2_ReadBusy();
}

static void EPD_2IN7_V2_TurnOnDisplay_Fast(void)
{
	EPD_2IN7_V2_SendCommand(0x22); //Display Update Control
	EPD_2IN7_V2_SendData(0xC7);
	EPD_2IN7_V2_SendCommand(0x20); //Activate Display Update Sequence
	EPD_2IN7_V2_ReadBusy();
}

static void EPD_2IN7_V2_TurnOnDisplay_Partial(void)
{
	EPD_2IN7_V2_SendCommand(0x22);
	EPD_2IN7_V2_SendData(0xFF);
	EPD_2IN7_V2_SendCommand(0x20);
	EPD_2IN7_V2_ReadBusy();
}

/******************************************************************************
function :	Initialize the e-Paper register
parameter:
******************************************************************************/
void EPD_2IN7_V2_Init(void)
{
    EPD_2IN7_V2_Reset();
    EPD_2IN7_V2_ReadBusy();

    EPD_2IN7_V2_SendCommand(0x12); //SWRESET
    EPD_2IN7_V2_ReadBusy();

    EPD_2IN7_V2_SendCommand(0x45); //set Ram-Y address start/end position          
    EPD_2IN7_V2_SendData(0x00);
    EPD_2IN7_V2_SendData(0x00);
    EPD_2IN7_V2_SendData(0x07); //0x0107-->(263+1)=264
    EPD_2IN7_V2_SendData(0x01);

    EPD_2IN7_V2_SendCommand(0x4F);   // set RAM y address count to 0;    
    EPD_2IN7_V2_SendData(0x00);
    EPD_2IN7_V2_SendData(0x00);

    EPD_2IN7_V2_SendCommand(0x11);   // data entry mode
    EPD_2IN7_V2_SendData(0x03);

}
void EPD_2IN7_V2_Init_Fast(void)
{
	EPD_2IN7_V2_Reset();
	EPD_2IN7_V2_ReadBusy();

	EPD_2IN7_V2_SendCommand(0x12); //SWRESET
	EPD_2IN7_V2_ReadBusy();

	EPD_2IN7_V2_SendCommand(0x18); //Read built-in temperature sensor
	EPD_2IN7_V2_SendData(0x80);	

	EPD_2IN7_V2_SendCommand(0x22); // Load temperature value
	EPD_2IN7_V2_SendData(0xB1);		
	EPD_2IN7_V2_SendCommand(0x20);	
	EPD_2IN7_V2_ReadBusy();

	EPD_2IN7_V2_SendCommand(0x1A); // Write to temperature register
	EPD_2IN7_V2_SendData(0x64);		
	EPD_2IN7_V2_SendData(0x00);	

	EPD_2IN7_V2_SendCommand(0x45); //set Ram-Y address start/end position          
	EPD_2IN7_V2_SendData(0x00);   
	EPD_2IN7_V2_SendData(0x00);
	EPD_2IN7_V2_SendData(0x07); //0x0107-->(263+1)=264
	EPD_2IN7_V2_SendData(0x01);

	EPD_2IN7_V2_SendCommand(0x4F);   // set RAM y address count to 0;    
	EPD_2IN7_V2_SendData(0x00);
	EPD_2IN7_V2_SendData(0x00);

	EPD_2IN7_V2_SendCommand(0x11);   // data entry mode      
	EPD_2IN7_V2_SendData(0x03);
							
	EPD_2IN7_V2_SendCommand(0x22); // Load temperature value
	EPD_2IN7_V2_SendData(0x91);		
	EPD_2IN7_V2_SendCommand(0x20);	
	EPD_2IN7_V2_ReadBusy(); 
}

/******************************************************************************
function :	Clear screen
parameter:
******************************************************************************/
void EPD_2IN7_V2_Clear(void)
{
    UWORD Width, Height;
    Width = (EPD_2IN7_V2_WIDTH % 8 == 0)? (EPD_2IN7_V2_WIDTH / 8 ): (EPD_2IN7_V2_WIDTH / 8 + 1);
    Height = EPD_2IN7_V2_HEIGHT;

    EPD_2IN7_V2_SendCommand(0x24);
    for (UWORD j = 0; j < Height; j++) {
        for (UWORD i = 0; i < Width; i++) {
            EPD_2IN7_V2_SendData(0XFF);
        }
    }

	EPD_2IN7_V2_TurnOnDisplay();
}
#if 0
/******************************************************************************
function :	Sends the image buffer in RAM to e-Paper and displays
parameter:
******************************************************************************/
void EPD_2IN7_V2_Display(UBYTE *Image)
{
	EPD_2IN7_V2_SendCommand(0x24);
	DEV_SPI_WriteBuffer(Image,EPD_FRAMEBUF_SIZE_2SCALE);
}
#else
/******************************************************************************
function :	Sends the image buffer in RAM to e-Paper and displays
parameter:
******************************************************************************/
void EPD_2IN7_V2_Display(UBYTE *Image)
{
	UWORD Width, Height;
	Width = (EPD_2IN7_V2_WIDTH % 8 == 0)? (EPD_2IN7_V2_WIDTH / 8 ): (EPD_2IN7_V2_WIDTH / 8 + 1);
	Height = EPD_2IN7_V2_HEIGHT;

	EPD_2IN7_V2_SendCommand(0x24);
	for (UWORD j = 0; j < Height; j++) {
			for (UWORD i = 0; i < Width; i++) {
					EPD_2IN7_V2_SendData(Image[i + j * Width]);
			}
	}

	EPD_2IN7_V2_TurnOnDisplay();
}
#endif
void EPD_2IN7_V2_Display_Partial(UBYTE *Image, UWORD Xstart, UWORD Ystart, UWORD Xend, UWORD Yend)
{
	if((Xstart % 8 + Xend % 8 == 8 && Xstart % 8 > Xend % 8) || Xstart % 8 + Xend % 8 == 0 || (Xend - Xstart)%8 == 0)
	{
			Xstart = Xstart / 8 ;
			Xend = Xend / 8;
	}
	else
	{
			Xstart = Xstart / 8 ;
			Xend = Xend % 8 == 0 ? Xend / 8 : Xend / 8 + 1;
	}


	UWORD Width;
	Width = Xend -  Xstart;
	UWORD IMAGE_COUNTER = Width * (Yend-Ystart);

	Xend -= 1;
	Yend -= 1;	
	//Reset
	EPD_2IN7_V2_Reset();

	EPD_2IN7_V2_SendCommand(0x3C); //BorderWavefrom
	EPD_2IN7_V2_SendData(0x80);	
	//	
	EPD_2IN7_V2_SendCommand(0x44);       // set RAM x address start/end, in page 35
	EPD_2IN7_V2_SendData(Xstart & 0xff);    // RAM x address start at 00h;
	EPD_2IN7_V2_SendData(Xend & 0xff);    // RAM x address end at 0fh(15+1)*8->128 
	EPD_2IN7_V2_SendCommand(0x45);       // set RAM y address start/end, in page 35
	EPD_2IN7_V2_SendData(Ystart & 0xff);    // RAM y address start at 0127h;
	EPD_2IN7_V2_SendData((Ystart>>8) & 0x01);    // RAM y address start at 0127h;
	EPD_2IN7_V2_SendData(Yend & 0xff);    // RAM y address end at 00h;
	EPD_2IN7_V2_SendData((Yend>>8) & 0x01); 

	EPD_2IN7_V2_SendCommand(0x4E);   // set RAM x address count to 0;
	EPD_2IN7_V2_SendData(Xstart & 0xff); 
	EPD_2IN7_V2_SendCommand(0x4F);   // set RAM y address count to 0X127;    
	EPD_2IN7_V2_SendData(Ystart & 0xff);
	EPD_2IN7_V2_SendData((Ystart>>8) & 0x01);


	EPD_2IN7_V2_SendCommand(0x24);   //Write Black and White image to RAM
	DEV_SPI_WriteBuffer(Image,IMAGE_COUNTER);
	EPD_2IN7_V2_TurnOnDisplay_Partial();
}


/******************************************************************************
function :	Enter sleep mode
parameter:
******************************************************************************/
void EPD_2IN7_V2_Sleep(void)
{
    EPD_2IN7_V2_SendCommand(0X10);
    EPD_2IN7_V2_SendData(0x01);
}

void EPD_Init(void)
{
   DEV_Module_Exit();
}
static void EPD_Start(bool fastmode)
{
	DEV_Module_Init();
	EPD_2IN7_V2_Init();
	if(fastmode)
	{
	    EPD_2IN7_V2_Clear();
		EPD_2IN7_V2_Init_Fast();
	}
}

void EPD_Exit()
{
	//EPD_2IN7_V2_Init();
    EPD_2IN7_V2_Sleep();
    DEV_Delay_ms(200);
    //DEV_Module_Exit();
}


//EPD_Display_Fast
void EPD_Display_Fast(ePaperFrame_t* pframe)
{
	EPD_Start(true);
	EPD_2IN7_V2_Display((UBYTE *)pframe->bmp.body);
	EPD_2IN7_V2_TurnOnDisplay_Fast();
	EPD_Exit();
}

void EPD_Display(ePaperFrame_t* pframe)
{
	EPD_Start(false);
	DEV_Delay_ms(50);
	EPD_2IN7_V2_Display((UBYTE *)pframe->bmp.body);
	DEV_Delay_ms(50);
	EPD_2IN7_V2_TurnOnDisplay();
	DEV_Delay_ms(50);
	EPD_Exit();
}

void EPD_Display_Partial(ePaperFrame_t* pblock)
{
	if(EPD_TYPE_BLOCK == pblock->type)
	{
		EPD_Start(false);
		EPD_2IN7_V2_Display_Partial((UBYTE *)pblock->bmp.body,pblock->pos.X_s,pblock->pos.Y_s,pblock->pos.X_e,pblock->pos.Y_e);
		EPD_Exit();
	}
}

#if 0
void Paint_SetPixel(uint16_t Xpoint, uint16_t Ypoint, UWORD Color)
{
    
        UDOUBLE Addr = Xpoint / 8 + Y * Paint.WidthByte;
        UBYTE Rdata = Paint.Image[Addr];
        if(Color == BLACK)
            Paint.Image[Addr] = Rdata & ~(0x80 >> (X % 8));
        else
            Paint.Image[Addr] = Rdata | (0x80 >> (X % 8));
   
}
#endif


static uint8_t load_epaperfile()
{
	FIL fp; 
	uint8_t file[] = "2:epaper/epaper.bin";
	uint8_t head[6];
	uint32_t len;
	if(false == IntFlash_Open(&fp,file))
	{
		TRACELOG_DEBUG("Open epaper file fail...");
		return false;
	}

	f_read(&fp, head, 6, &len);
	if(len != 6)
	{
		TRACELOG_DEBUG("Load epaper file head fail...");
		IntFlash_Close(&fp);
		return false;
	}
	
	f_read(&fp, (uint8_t*)Hinata.bmp.body, EPD_FRAMEBUF_SIZE_2SCALE, &len);
	if(len != EPD_FRAMEBUF_SIZE_2SCALE)
	{
		TRACELOG_DEBUG("Load epaper file body fail...");
		IntFlash_Close(&fp);
		return false;
	}
	IntFlash_Close(&fp);
	//TRACELOG_DEBUG("Load epaper file body success...");
	return true;
}

void EPD_StartShow()
{
	//HAL_Delay(10000);
	if(MEM_FlagBit_IsEnabled(MEM_FLAG_EPAPBIN)&&(load_epaperfile()))
	{	
		//TRACELOG_DEBUG("Load epaper fail...");
		MEM_FlagBit_Reset(MEM_FLAG_EPAPBIN);
		EPD_Display(&Hinata);	
		return;
	}
	//TRACELOG_DEBUG("show Hinata");
	
}

#ifdef TEST_EPAPER


#include "tracelog.h"

void test_showbit()
{
	memset(Hinata.bmp.body,0,5808);
	Hinata.bmp.body[0] = 0xff;
}
void testcase_ePaper(void)
{
	TRACELOG_DEBUG("Running testcase_ePaper...");
	TRACELOG_DEBUG("\t Show Hinata");
	EPD_Display(&Hinata);
	DEV_Delay_ms(3000);
	TRACELOG_DEBUG("testcase_ePaper end...");
}


#endif
#endif

